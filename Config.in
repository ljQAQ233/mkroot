## Config.in
```kconfig
mainmenu "Buildroot-style Demo"

source "osimage/Config.in"
source "package/Config.in"
```

## configs/hello_defconfig
```kconfig
#
# Image
#
CONFIG_OSIMAGE_REMOTE_TAG="latest"
CONFIG_OSIMAGE_KERNEL_PATH=""
CONFIG_OSIMAGE_EFIBOOT_PATH=""
CONFIG_OSIMAGE_LDSO_PATH=""
# CONFIG_OSIMAGE_APPLY_BUNDLE is not set
# end of Image

#
# Packages
#
CONFIG_HELLO=y

#
# hello
#
CONFIG_HELLO_STRING="Hello world"
CONFIG_HELLO_INTEGER=42
CONFIG_HELLO_NCURSES=y
# end of hello

CONFIG_NCURSES=y

#
# ncurses
#
# CONFIG_NCURSES_DEBUG is not set
# end of ncurses
# end of Packages
```

## osimage/Config.in
```kconfig
menu "Image"

config OSIMAGE_REMOTE_TAG
    string "Pre-compiled bundle's remote tag"
    default "latest"
    help
        The tag of a release which contains root.tar.gz

config OSIMAGE_KERNEL_PATH
    string "Customize kernel path"
    default ""

config OSIMAGE_EFIBOOT_PATH
    string "Customize EFI bootloader path"
    default ""

config OSIMAGE_LDSO_PATH
    string "Customize dynamic linker (ldso) path"
    default ""

config OSIMAGE_APPLY_BUNDLE
    bool "Apply apps and libs in bundle (root.tar.gz) to image"
    default false

endmenu
```

## package/Config.in
```kconfig
menu "Packages"

config HELLO
    bool "hello"
    help
        a program printing out `Hello world`

source "package/hello/Config.in"

endmenu
```

## package/hello/Config.in
```kconfig
if HELLO

menu "hello"

config HELLO_STRING
    string "String to print"
    default "Hello world"

config HELLO_INTEGER
    int "Integer to print"
    default 42

config HELLO_NCURSES
    bool "Enable ncurses demo"
    default true
    depends on NCURSES

endmenu

endif
```

## package/ncurses/Config.in
```kconfig
if NCURSES

menu "ncurses"

config NCURSES_DEBUG
    bool "Enable debug"
    default false
    depends on NCURSES

endmenu

endif
```
